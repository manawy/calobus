## drivers/zephyr/sensor/Kconfig
```kconfig
menu "custom device drivers"

config FLUXSENSOR
    bool "flux sensor"
    default n
    help
        Custom flux sensor

rsource "ti/Kconfig"
rsource "zephyr/Kconfig"

endmenu
```

## drivers/zephyr/sensor/ti/ads1115sensor/Kconfig
```kconfig
# ADS1115 as sensor configuration options

# Copyright (c) 2026 F. Georget
# SPDX-License-Identifier: Apache-2.0

menuconfig ADS1115SENSOR
	bool "ADS1115 Differential voltage Sensor"
	default y
	depends on DT_HAS_TI_ADS1115SENSOR_ENABLED
	select I2C
    select FLUXSENSOR
	help
	  Enable driver for ADS1115 voltage sensor (custom)

if ADS1115SENSOR

config ADS1115SENSOR_CONTINUOUS
    bool
    default n
    help
      Enables continuous measurement mode

endif # ADS1115SENSOR
```

## drivers/zephyr/sensor/zephyr/fluxsensor/Kconfig
```kconfig
# Copyright (c) 2026 F. Georget
# SPDX-License-Identifier: Apache-2.0

# Emulation


menuconfig EMULFLUXSENSOR
	bool "Emulated flux sensor"
	default y
	depends on DT_HAS_ZEPHYR_EMUL_FLUXSENSOR_ENABLED
    select FLUXSENSOR
	help
	  Enable driver for emulated fluxsensor
```

## drivers/zephyr/sensor/zephyr/tempsensor/Kconfig
```kconfig
# Copyright (c) 2026 F. Georget
# SPDX-License-Identifier: Apache-2.0

# Emulation


menuconfig EMULTEMPSENSOR
	bool "Emulated temperature sensor"
	default y
	depends on DT_HAS_ZEPHYR_EMUL_TEMPSENSOR_ENABLED
	help
	  Enable driver for emulated fluxsensor
```
