## src/Kconfig.measure
```kconfig
# Copyright (c) 2026 Fabien Georget
# SPDX-License-Identifier: Apache-2.0
#

config HEARTBEAT_MSEC
    int "Measurement heartbeat in msec"
    default 100
    help
        The default measurement period

config OVERSAMPLING
    int "Number of samples to average"
    default 10
    help
        The number of samples to average

config HEALTHCHECK_BEAT_SECONDS
    int "Health Check period in seconds"
    default 60
    help
        The default health check period

config NB_WRITE_FLUSH
    int "Flush data to disk after x write"
    default 25
    help
        File is sync after this number of write
```

## src/Kconfig.threads
```kconfig
# Copyright (c) 2026 Fabien Georget
# SPDX-License-Identifier: Apache-2.0

config WAIT_CONSOLE_INIT
    bool "Wait for console"
    default false
    help
        If true, wait for console

config SENSOR_THREAD_PRIORITY
    int "Sensor thread priority"
    default 3
    help
        Priority of the datalogger thread

config PROCESSING_THREAD_PRIORITY
    int "Processing thread priority"
    default 5
    help 
        Priority of the processing thread

config DATALOGGER_THREAD_PRIORITY
    int "Datalogger thread priority"
    default 5
    help
        Priority of the datalogger
```
